## Platform/Embedded/Zephyr/drivers/Kconfig
```kconfig
# SPDX-FileCopyrightText: Copyright (c) 2024 Qorvo, Inc.
# SPDX-License-Identifier: LicenseRef-QORVO-2

menu "Drivers"
rsource "uwb/Kconfig"
endmenu
```

## Platform/Embedded/Zephyr/drivers/uwb/Kconfig
```kconfig
# SPDX-FileCopyrightText: Copyright (c) 2024 Qorvo, Inc.
# SPDX-License-Identifier: LicenseRef-QORVO-2

rsource "qm357xx/Kconfig"
```

## Platform/Embedded/Zephyr/drivers/uwb/qm357xx/Kconfig
```kconfig
# SPDX-FileCopyrightText: Copyright (c) 2024 Qorvo, Inc.
# SPDX-License-Identifier: LicenseRef-QORVO-2

config HSSPI
	bool "QM35 HSSPI driver"
	default y
	#depends on DT_HAS_ZEPHYR_HSSPI_ENABLED
	select GPIO
	select SPI
	help
	  Enable hsspi driver
```

## Platform/Embedded/Zephyr/dts/bindings/hsspi/qorvo,hsspi.yaml
```yaml
# SPDX-FileCopyrightText: Copyright (c) 2024 Qorvo, Inc.
# SPDX-License-Identifier: LicenseRef-QORVO-2

description: |
  HSSPI Driver

  Example definition in devicetree:

      hsspi0: hsspi@102000 {
        compatible = "qorvo-hsspi";
        label = "SPI_0";
        status = "okay";
        spi-driver = < &spi1 >;
        ss-irq-gpios = < &gpio1 0x1 0x0 >;
        reset-gpios = < &gpio1 0x2 0x1 >;
      };

compatible: "qorvo,hsspi"

include: spi-device.yaml

properties:
  ss-irq-gpios:
    type: phandle-array
    required: true
  reset-gpios:
    type: phandle-array
    required: true
  exton-gpios:
    type: phandle-array
    required: false
```

## Platform/Linux/Drivers/linux-drivers/kernel/Documentation/devicetree/bindings/spi/qm/qm35.txt
```
QM35 SPI modular driver

Required properties:

	- compatible: 				"qorvo,qm35_spi"

	- reg:					chip-select index used by the device.
						Set to <0> or <1>.

	- interrupts-extended or interrupts:	interrupt line used by the qm35 chip to wakeup
						the host processor upon activity.
						Deprecated and cannot be used as the same time as "irq-gpios", see below.

	- pinctrl-0:				pin control group to be used for this controller.

	- pinctrl-names:			must contain a "default" entry.

	- spi-max-frequency:			max frequency supported by the QM35 chip (or the routed board
						that handles the chip).
						Set to 40000000 which is the max supported speed of QM35.
						Use a more conservative value if QM35 is connected to its host using
						very long traces on board.

	- reset-gpios:				reset GPIO to use to perform a hard reset of the QM35 chip.

	- irq-gpios:				GPIO pin to use as an IRQ line through the GPIOLIB framework.
						Using this property instead of "interrupts" is required to be able to
						use the chip's boot ROM command mode and update its firmware.

Optional properties:
	- vdd1_reg-supply: 			regulator that powers the qm35 device.

	- vdd2_reg-supply: 			regulator that powers the qm35 device.

	- vdd3_reg-supply: 			regulator that powers the qm35 device.

	- vdd4_reg-supply: 			regulator that powers the qm35 device.

	- vdd5_reg-supply: 			regulator that powers the qm35 device.

	- power_reg-supply: 			regulator that powers the qm35 device. Deprecated.

	- power_reg_1p8-supply:			regulator that powers a 1.8V line of the qm35 device. Deprecated.

	- power_reg_2p5-supply:			regulator that powers a 2.5V line of the qm35 device. Deprecated.

	- regulator_delay_us:			delay in us to wait after regulator(s) state is changed.
						Default is 1000 us.

	- exton-gpios:				GPIO pin to use as a validator of the qm35's state
						When defined, this gpio is used to confirm if the qm35
						is awake or not.

	- ready-gpios: 				GPIO pin to use as a validator of the qm35's state
						When defined, this gpio is used to confirm if the qm35 is
						ready before using it.

	- wakeup-gpios:				GPIO pin to use as an IRQ.
						When defined, this pin is used to wake up the qm35.

	- cpu:					CPU# on which the QM35 worker thread will run.
						If not set, processing thread is not bound to a specific CPU and
						the scheduler may move it, adding latencies.

	- qos_latency:				latency request to PM QoS on active ranging in microseconds.
						default is 0, the minimum PM QoS latency.

	- hsspi_delay_us:			delay added before each SPI transfers in qm35_hsspi_recv()
						and qm35_hsspi_send().
						Default is 0us.

	- debug_flags:				debug flags bit-field:
							- bit 0: RESERVED. Reserved for future use.
							- bit 1: AUTO_TRACE. If set, automatically enable traces
							  for qm35_spi and qm35 events modules.
							- bit 2: FORCE_FW_UPDATE. If set, force the firmware update.
							- bit 3: NO_FW_UPDATE. Disable firmware flashing completely.
							- bit 4: NO_RESET_ON_SUSPEND: Disable holding reset in PM
							  suspend callback.
							- bit 5: COMBINED_WRITE: Allow combined read/write while
							  receiving a frame.
							- bit 6: AUTO_LOAD_OPTIONAL: Automatically load optional
							  modules.
							- bit 7: NO_PROBING: Disable probing. Assume device always
							  present.
							- bit 8: LOW_GPIO: Bypass ready, wakeup and exton GPIOs setup,
                                                          even if defined in the DT.

	- fw_name:				name of the firmware file to be loaded, replacing the default one.

Example:
        /* QM35 */
        qm35@0 {
            compatible = "qorvo,qm35_spi";
            reg = <0>;

            pinctrl-names = "default";
            pinctrl-0 = <&qm35_default_state>;

            spi-max-frequency = <40000000>;

            irq-gpios =  <&tlmm 49 GPIO_ACTIVE_HIGH>;
            reset-gpios = <&tlmm 50 GPIO_ACTIVE_LOW>;

            power_reg-supply = <&qm35_regulator>;

            cpu = <1>;
            qos_latency = <0>;
            regulator_delay_us = <1000>;

            status = "okay";
        };
```

## Platform/Linux/Drivers/linux-drivers/kernel/Documentation/devicetree/bindings/spi/qm/qorvo,qm35.yaml
```yaml
# SPDX-License-Identifier: (GPL-2.0 OR BSD-2-Clause)
%YAML 1.2
---
$id: http://devicetree.org/schemas/spi/qm/qorvo,qm35.yaml#
$schema: http://devicetree.org/meta-schemas/core.yaml#

title: Qorvo's QM35 SPI modular driver

maintainers:
  - Alexandre Boeglin <alexandre.boeglin@qorvo.com>
  - David Girault <david.girault@qorvo.com>

properties:
  compatible:
    const: qorvo,qm35_spi

  reg:
    description:
      Chip-select index used by the device. Set to <0> or <1>.
    maxItems: 1

  interrupts:
    description:
      Interrupt line used by the qm35 chip to wakeup the host processor upon
      activity. Cannot be used as the same time as "irq-gpios", see below.
    maxItems: 1

  spi-max-frequency:
    description:
      Max frequency supported by the QM35 chip (or the routed board that handles
      the chip). 40000000 is the max supported speed of QM35.
      Use a more conservative value if QM35 is connected to its host using very
      long traces on board or with level-shifters.

  reset-gpios:
    description: GPIO connected to the active low reset pin.
    maxItems: 1

  irq-gpios:
    description:
      GPIO pin to use as an IRQ line through the GPIOLIB framework.
      Using this property instead of "interrupts" is required to be able to
      use the chip's boot ROM command mode and update its firmware.
    maxItems: 1

  vdd1_reg-supply:
    $ref: /schemas/types.yaml#/definitions/phandle
    description:
      Phandle to voltage regulator that powers the QM35 device.
    maxItems: 1

  vdd2_reg-supply:
    $ref: /schemas/types.yaml#/definitions/phandle
    description:
      Phandle to voltage regulator that powers the QM35 device.
    maxItems: 1

  vdd3_reg-supply:
    $ref: /schemas/types.yaml#/definitions/phandle
    description:
      Phandle to voltage regulator that powers the QM35 device.
    maxItems: 1

  vdd4_reg-supply:
    $ref: /schemas/types.yaml#/definitions/phandle
    description:
      Phandle to voltage regulator that powers the QM35 device.
    maxItems: 1

  vdd5_reg-supply:
    $ref: /schemas/types.yaml#/definitions/phandle
    description:
      Phandle to voltage regulator that powers the QM35 device.
    maxItems: 1

  power_reg-supply:
    $ref: /schemas/types.yaml#/definitions/phandle
    description:
      Phandle to voltage regulator that powers the QM35 device. Deprecated.
    maxItems: 1

  power_reg_1p8-supply:
    $ref: /schemas/types.yaml#/definitions/phandle
    description:
      Phandle to voltage regulator that powers a 1.8V line of the QM35 device. Deprecated.
    maxItems: 1

  power_reg_2p5-supply:
    $ref: /schemas/types.yaml#/definitions/phandle
    description:
      Phandle to voltage regulator that powers a 2.5V line of the QM35 device. Deprecated.
    maxItems: 1

  regulator_delay_us:
    $ref: /schemas/types.yaml#/definitions/uint32
    description:
      Delay in us to wait after regulator(s) state is changed.
      Default is 1000 us.
    maxItems: 1

  exton-gpios:
    description:
      GPIO pin to use as a validator of the QM35's state.
      When defined, this gpio is used to confirm if the QM35
      is awake or not.
    maxItems: 1

  ready-gpios:
    description:
      GPIO pin to use as a validator of the qm35's state.
      When defined, this gpio is used to confirm if the qm35 is
      ready before using it.
    maxItems: 1

  wakeup-gpios:
    description:
      GPIO pin to use as an IRQ.
      When defined, this pin is used to wake up the qm35.
    maxItems: 1

  cpu:
    $ref: /schemas/types.yaml#/definitions/uint32
    description:
      CPU# on which the QM35 worker thread will run.
      If not set, processing thread is not bound to a specific CPU and the
      scheduler may move it, adding latencies.
    maxItems: 1

  qos_latency:
    $ref: /schemas/types.yaml#/definitions/uint32
    description:
      Latency request to PM QoS on active ranging in microseconds. Default
      is 0, the minimum PM QoS latency.
    maxItems: 1

  hsspi_delay_us:
    $ref: /schemas/types.yaml#/definitions/uint32
    description:
      Delay added before each SPI transfers. Default is 0us.

  debug_flags:
    $ref: /schemas/types.yaml#/definitions/uint32
    description: |
      Set the driver debug_flags bit-field to enable/disable some features.

      The available bits are:
      - bit 0: RESERVED. Reserved for future use.
      - bit 1: AUTO_TRACE. If set, automatically enable traces for qm35_spi
        and qm35 events modules.
      - bit 2: FORCE_FW_UPDATE. If set, force the firmware update.
      - bit 3: NO_FW_UPDATE. Disable firmware flashing completely.
      - bit 4: NO_RESET_ON_SUSPEND: Disable holding reset in PM suspend
        callback.
      - bit 5: COMBINED_WRITE: Allow combined read/write while receiving a
        frame.
      - bit 6: AUTO_LOAD_OPTIONAL: Automatically load optional modules.
      - bit 7: NO_PROBING: Disable probing. Assume device always present.
      - bit 8: LOW_GPIO: Bypass ready, wakeup and exton GPIOs setup, even if
        defined in the DT.

  fw_name:
    $ref: /schemas/types.yaml#/definitions/string
    description:
      Name of the firmware file to be loaded, replacing the default one.

required:
  - compatible
  - reg
  - spi-max-frequency
  - reset-gpios
  - irq-gpios

examples:
  - |
    qm35@0 {
        compatible = "qorvo,qm35_spi";
        reg = <0>;

        pinctrl-names = "default";
        pinctrl-0 = <&qm35_default_state>;

        spi-max-frequency = <40000000>;

        irq-gpios =  <&tlmm 49 GPIO_ACTIVE_HIGH>;
        reset-gpios = <&tlmm 50 GPIO_ACTIVE_LOW>;

        power_reg-supply = <&qm35_regulator>;

        cpu = <1>;
        qos_latency = <0>;
        regulator_delay_us = <1000>;

        status = "okay";
    };
```
